## conf/layer.conf
```bitbake
# We have a conf and classes directory, add to BBPATH
BBPATH .= ":${LAYERDIR}"

# We have recipes-* directories, add to BBFILES
BBFILES += "\
    ${LAYERDIR}/recipes-*/*/*.bb \
    ${LAYERDIR}/recipes-*/*/*.bbappend \
    "

BBFILE_COLLECTIONS += "fusion"
BBFILE_PATTERN_fusion = "^${LAYERDIR}/"
BBFILE_PRIORITY_fusion = "10"

LAYERDEPENDS_fusion = "linaro-toolchain go virtualization-layer"
```

## conf/machine/xenaarch64.conf
```bitbake
#@TYPE: Machine
#@NAME: generic armv8 machine
#@DESCRIPTION: Machine configuration for running a generic armv8

require conf/machine/include/arm/arch-armv8.inc

KERNEL_IMAGETYPE = "zImage"
IMAGE_FSTYPES = "tar.bz2"

SERIAL_CONSOLES = "115200 hvc0"

PREFERRED_PROVIDER_virtual/kernel = "linux-fusion"
```
